## apps/test_child/Kconfig
```kconfig
config APP_TEST_CHILD
    bool "Test Child"
    depends on LIB_SEL4 && HAVE_LIBC && LIB_SOS
    select HAVE_SEL4_APPS
    help
        This is a test program that acts as a child process
```

## apps/test_child_inf/Kconfig
```kconfig
config APP_TEST_CHILD_INF
    bool "Test Child Infinite"
    depends on LIB_SEL4 && HAVE_LIBC && LIB_SOS
    select HAVE_SEL4_APPS
    help
        This is a test program that acts as a child process in an infinite loop
```

## apps/test_parent/Kconfig
```kconfig
config APP_TEST_PARENT
    bool "Test Parent"
    depends on LIB_SEL4 && HAVE_LIBC && LIB_SOS
    select HAVE_SEL4_APPS
    help
        This is a test program for creating children processes
```
